## src/drivers/distance_sensor/dyp_a02/Kconfig
```kconfig
# 本项只决定是否将驱动编入固件；是否开机运行由VGS_RNG_EN另行控制。
menuconfig DRIVERS_DISTANCE_SENSOR_DYP_A02
	bool "dyp_a02"
	default n
	---help---
		DYP-A02 automatic-output UART ultrasonic distance sensor.
```

## src/modules/vgsolar_encoders/Kconfig
```kconfig
menuconfig MODULES_VGSOLAR_ENCODERS
	bool "vgsolar_encoders"
	default n
	---help---
		VGSolar left/right wheel encoder raw quadrature count diagnostics.
```

## src/modules/vgsolar_esc/Kconfig
```kconfig
menuconfig MODULES_VGSOLAR_ESC
	bool "vgsolar_esc"
	default n
	---help---
		Read-only 2BLD6010 Modbus RTU telemetry on VGSolar UART4.
```

## src/modules/vgsolar_inputs/Kconfig
```kconfig
menuconfig MODULES_VGSOLAR_INPUTS
	bool "vgsolar_inputs"
	default n
	---help---
		VGSolar suction pressure ADC and lift infrared input diagnostics.
```

## src/modules/vgsolar_link/Kconfig
```kconfig
menuconfig MODULES_VGSOLAR_LINK
	bool "vgsolar_link"
	default n
	---help---
		Read-only NCU UART link and APM-compatible status feedback for VGSolar.
```

## src/modules/vgsolar_mode/Kconfig
```kconfig
menuconfig MODULES_VGSOLAR_MODE
	bool "vgsolar_mode"
	default n
	---help---
		Commander-registered VGSolar robot mode with navigation, suction turns and default-disabled cleaner outputs.
```

## src/modules/vgsolar_safety/Kconfig
```kconfig
# 编译开关和开机启用参数VGS_SAFE_EN相互独立。
menuconfig MODULES_VGSOLAR_SAFETY
	bool "vgsolar_safety"
	default n
	---help---
		VGSolar DYP-A02 edge monitor and latched stop request diagnostics.
```
